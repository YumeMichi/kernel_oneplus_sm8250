## drivers/oneplus/Kconfig
```kconfig
source "drivers/oneplus/boot-mode/Kconfig"
source "drivers/oneplus/input/Kconfig"
source "drivers/oneplus/tri-state-key/Kconfig"
source "drivers/oneplus/power/Kconfig"
source "drivers/oneplus/project-info/Kconfig"
source "drivers/oneplus/vibrator/Kconfig"
source "drivers/oneplus/vl53L1/Kconfig"
```

## drivers/oneplus/boot-mode/Kconfig
```kconfig
config OEM_BOOT_MODE
    bool "detect oem boot mode"
    default n
    help
        detect oem boot mode  If unsure, say y.
```

## drivers/oneplus/houston/Kconfig
```kconfig
config HOUSTON
    bool "houston"
    default n
    help
      houston  If unsure, say n.
```

## drivers/oneplus/project-info/Kconfig
```kconfig
config PROJECT_INFO
    bool "detect project info"
    default n
    help
      detect projcet info  If unsure, say n.
```
